// SPDX-License-Identifier: GPL-2.0-only
//
// J501 Mini RS485 (JST J8, /dev/ttyTHS4) bring-up via GPIO hogs.
//
// The onboard RS485 transceiver + its 120R termination are gated by two GPIOs
// that must be held low (Seeed reComputer J501 Mini wiki, "RS485"):
//   gpioset 0 126=0  -> RS485 transceiver enable  (gpiochip0 line 126 = PY.04)
//   gpioset 1 9=0    -> 120R termination enable    (gpiochip1 line 9   = PBB.01)
//
// A hog's `gpios` cell is the DT specifier TEGRA234_{MAIN,AON}_GPIO(port,pin) =
// port_index*8 + pin, using the port indices from dt-bindings/gpio/tegra234-gpio.h
// (the SAME table the driver's of_xlate uses). The MAIN port table is sparse in
// letters: ... R=16, X=17, Y=18, Z=19 ... (S..W and AA/AB are not gpio ports),
// so the DT cell is NOT the dense libgpiod/`gpioset` line number.
//   PY.04  = MAIN(Y=18, 4) = 148   (libgpiod line 126)
//   PBB.01 = AON (BB=1,  1) = 9     (libgpiod line 9)
// Verified against the same header: MAIN(H,6)=62=PH.06, MAIN(Q,6)=126=PQ.06.
//
// Fragments target the controllers by path (not &phandle): the Jetson bootloader
// that applies OVERLAY_DTB_FILE does not resolve __fixups__.
//
// Delivery: this ships in the NixOS closure (hardware.j501.rs485.enable) and is
// applied by the firmware capsule on OTA — NOT by recovery-mode reflash, which
// firmware.autoUpdate reverts to match the deployed closure.

/dts-v1/;
/plugin/;

/ {
	overlay-name = "J501 Mini RS485 enable";

	// Only the transceiver-enable is hogged. The 120R termination (PBB.01 /
	// aon gpio line 9) is intentionally NOT hogged so it can be toggled from
	// userspace for bring-up experiments (float at boot).
	fragment@0 {
		target-path = "/bus@0/gpio@2200000";
		__overlay__ {
			rs485-enable-hog {
				gpio-hog;
				gpios = <148 0>; /* MAIN(Y,4)=PY.04; 0=ACTIVE_HIGH, output-low = phys 0 */
				output-low;
				line-name = "rs485-enable";
			};
		};
	};

	// NOTE: the DE line itself (PY.07 / rs485-de-gpios) is left at the base
	// recomputer DTB's stock definition (ACTIVE_LOW). The patched serial-tegra
	// driver inverts in software (assert = gpiod 0 -> phys high = transmit),
	// matching Seeed's proven driver, and always manages DE when the rs485-de
	// gpio is present, so no serial-node override or boot-time-enable is needed.
};
